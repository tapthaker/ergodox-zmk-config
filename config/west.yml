## config/west.yml
```yaml
manifest:
  remotes:
    - name: slicemk
      url-base: https://github.com/xudongzheng
  projects:
    - name: zmk
      remote: slicemk
      revision: v20250120-min
      import: app/west.yml
  self:
    path: config
```
